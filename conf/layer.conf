## conf/layer.conf
```bitbake
# We have a conf and classes directory, append to BBPATH
BBPATH .= ":${LAYERDIR}"

# We have a recipes directory, add to BBFILES
BBFILES += "${LAYERDIR}/recipes*/*/*.bb \
            ${LAYERDIR}/recipes*/*/*.bbappend"

BBFILE_COLLECTIONS += "imx-iotedge-layer"
BBFILE_PATTERN_imx-iotedge-layer := "^${LAYERDIR}/"
BBFILE_PRIORITY_imx-iotedge-layer = "5"

LAYERSERIES_COMPAT_imx-iotedge-layer = "sumo thud warrior zeus"

# Add the NXP-specific licenses into the metadata
LICENSE_PATH += "${LAYERDIR}/custom-licenses"

# Add LAYERSERIES_COMPAT to Zeus for layer meta-iotedge and meta-virtualization
LAYERSERIES_COMPAT_meta-iotedge += "zeus"
LAYERSERIES_COMPAT_virtualization-layer += "zeus"

# BBMASK for branch thud of meta-virtualization
BBMASK += "meta-virtualization/recipes-kernel/linux/linux-yocto_4.14.bbappend"
BBMASK += "meta-virtualization/recipes-kernel/linux/linux-yocto_4.18.bbappend"

# FIXME: meta-iotedge thud branch only build successful with Rust/Cargo v1.37.0 from meta-rust
PREFERRED_VERSION_cargo-native = "1.37.0"
PREFERRED_VERSION_rust-native = "1.37.0"
PREFERRED_VERSION_rust-llvm-native = "1.37.0"
PREFERRED_VERSION_libstd-rs = "1.37.0"
PREFERRED_VERSION_rust-cross-${TARGET_ARCH} = "1.37.0"
```
